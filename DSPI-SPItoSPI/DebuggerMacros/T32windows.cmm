// T32 Fri Aug 31 17:03:51 2007

 B::
 
 TOOLBAR ON
 STATUSBAR ON
 WINPAGE.RESET
 
 WINCLEAR
 WINPOS 1.625 13.625 77. 20. 0. 0. W003
 r /spotlight
 
 WINPOS 99.625 0.5625 23. 4. 0. 0. W001
 Var.Watch %E %SPOTLIGHT Pit1Ctr     
 
 VAR.ADDWATCH SWirq4Ctr
 
 WINPOS 0.125 0.25 95. 9. 13. 1. W001
 WINTABS 10. 10. 25. 62.
 Data.List                 
 
 WINPAGE.SELECT P000     
 
 ENDDO
